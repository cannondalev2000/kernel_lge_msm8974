## arch/arm/hotplug/Kconfig
```kconfig
config MSM_LIMITER
	bool "MSM Frequency Limiter Driver"
	default y
	help
	  The MSM Frequency Limiter Driver controls max frequency limit for each CPU
	  to desired value on suspend/resume
```
